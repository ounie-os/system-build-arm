## package/mentohust/Config.in
```kconfig
config BR2_PACKAGE_MENTOHUST
	bool "mentohust"
	depends on BR2_PACKAGE_LIBPCAP
	help
	  client for hust campus network
```

## package/systemtap/Config.in
```kconfig
config BR2_PACKAGE_SYSTEMTAP
	bool "systemtap"
	depends on BR2_PACKAGE_LIBZLIB && BR2_PACKAGE_ELFUTILS
```
